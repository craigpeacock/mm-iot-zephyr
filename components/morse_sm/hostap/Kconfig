## components/morse_sm/hostap/Kconfig
```kconfig
# Copyright 2026 Morse Micro
# SPDX-License-Identifier: Apache-2.0

config MBEDTLS
	bool
	default y

config MBEDTLS_CONFIG_FILE
	string
	default "morse_mbedtls_config.h"

config MBEDTLS_ZEPHYR_ENTROPY
	bool
	default y
```
